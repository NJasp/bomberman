#include "Sprites.h"

void draw_Sprites(MI0283QT9 lcd, uint8_t grid[16][12]) {
	uint8_t pixelCounterX, pixelCounterY;
	uint32_t row, collumn, redPixelCounter = 0, greenPixelCounter = 1, bluePixelCounter = 2;
	uint8_t red, green, blue;
	static char const wallArray[1200] PROGMEM = { 0x3f,0x3d,0x3b,0x41,0x3f,0x3e,0x3a,0x38,0x37,0x27,0x26,0x26,0x3d,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0x3e,0x3b };
	static char const crateArray[1200] PROGMEM = { 0x91,0x71,0x4b,0xdf,0xc0,0x94,0xcd,0xac,0x81,0xc3,0xa4,0x78,0xcc,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0xb4,0x8b };

	for (row = 0; row < 12; row++) {
		for (collumn = 0; collumn < 16; collumn++) {
			if (grid[collumn][row] == 1) {
				//lcd.fillRect(collumn * 20, row * 20, 20, 20, RGB(0, 0, 0));
				for (pixelCounterY = 0; pixelCounterY < 20; pixelCounterY++) {
					for (pixelCounterX = 0; pixelCounterX < 20; pixelCounterX++) {
						//lcd.drawPixel((collumn * 20) + pixelCounterX, (row * 20) + pixelCounterY, RGB(pgm_read_byte_near(wallArray + redPixelCounter), pgm_read_byte_near(wallArray + greenPixelCounter), pgm_read_byte_near(wallArray + bluePixelCounter)));
						red = ((uint8_t)pgm_read_byte_near(wallArray + redPixelCounter));
						green = ((uint8_t)pgm_read_byte_near(wallArray + greenPixelCounter));
						blue = ((uint8_t)pgm_read_byte_near(wallArray + bluePixelCounter));
						lcd.drawPixel((collumn * 20) + pixelCounterX, (row * 20) + pixelCounterY, RGB(red, green, blue));
						redPixelCounter += 3;
						greenPixelCounter += 3;
						bluePixelCounter += 3;
					}
				}
				redPixelCounter = 0;
				greenPixelCounter = 1;
				bluePixelCounter = 2;
			}
			else {
				if (grid[collumn][row] == 2) {
					for (pixelCounterX = 0; pixelCounterX < 20; pixelCounterX++) {
						for (pixelCounterY = 0; pixelCounterY < 20; pixelCounterY++) {
							red = (uint8_t)pgm_read_byte_near(crateArray + redPixelCounter);
							green = (uint8_t)pgm_read_byte_near(crateArray + greenPixelCounter);
							blue = (uint8_t)pgm_read_byte_near(crateArray + bluePixelCounter);
							lcd.drawPixel((collumn * 20) + pixelCounterX, (row * 20) + pixelCounterY, RGB(red, green, blue));
							redPixelCounter += 3;
							greenPixelCounter += 3;
							bluePixelCounter += 3;
						}
					}
					redPixelCounter = 0;
					greenPixelCounter = 1;
					bluePixelCounter = 2;
				}
			}
		}
	}
}

void draw_PlayerSprite(MI0283QT9 lcd, uint8_t player1_x, uint8_t player1_y) {
	uint8_t pixelCounterX, pixelCounterY;
	uint32_t redPixelCounter = 0, greenPixelCounter = 1, bluePixelCounter = 2;
	uint8_t red, green, blue;
	static char const playerArray[1200] PROGMEM = { 0x66,0x66,0x66,0x66,0x66,0x66,0x66,0x66,0x66,0x66,0x66,0x66,0x64,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0x66,0x66 };
	for (pixelCounterY = 0; pixelCounterY < 20; pixelCounterY++) {
		for (pixelCounterX = 0; pixelCounterX < 20; pixelCounterX++) {
			//lcd.drawPixel((collumn * 20) + pixelCounterX, (row * 20) + pixelCounterY, RGB(pgm_read_byte_near(wallArray + redPixelCounter), pgm_read_byte_near(wallArray + greenPixelCounter), pgm_read_byte_near(wallArray + bluePixelCounter)));
			red = (uint8_t)pgm_read_byte_near(playerArray + redPixelCounter);
			green = (uint8_t)pgm_read_byte_near(playerArray + greenPixelCounter);
			blue = (uint8_t)pgm_read_byte_near(playerArray + bluePixelCounter);
			lcd.drawPixel((player1_x * 20) + pixelCounterX, (player1_y * 20) + pixelCounterY, RGB(red, green, blue));
			redPixelCounter += 3;
			greenPixelCounter += 3;
			bluePixelCounter += 3;
		}
	}
	redPixelCounter = 0;
	greenPixelCounter = 1;
	bluePixelCounter = 2;
}

void draw_BombSprite(MI0283QT9 lcd, uint8_t player1_x, uint8_t player1_y) {
	uint8_t pixelCounterX, pixelCounterY;
	uint32_t redPixelCounter = 0, greenPixelCounter = 1, bluePixelCounter = 2;
	uint8_t red, green, blue;
	static char const playerArray[1200] PROGMEM = { 0x66,0x66,0x66,0x66,0x66,0x66,0x66,0x66,0x66,0x66,0x66,0x66,0x66,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0x66,0x66 };
	for (pixelCounterY = 0; pixelCounterY < 20; pixelCounterY++) {
		for (pixelCounterX = 0; pixelCounterX < 20; pixelCounterX++) {
			//lcd.drawPixel((collumn * 20) + pixelCounterX, (row * 20) + pixelCounterY, RGB(pgm_read_byte_near(wallArray + redPixelCounter), pgm_read_byte_near(wallArray + greenPixelCounter), pgm_read_byte_near(wallArray + bluePixelCounter)));
			red = (uint8_t)pgm_read_byte_near(playerArray + redPixelCounter);
			green = (uint8_t)pgm_read_byte_near(playerArray + greenPixelCounter);
			blue = (uint8_t)pgm_read_byte_near(playerArray + bluePixelCounter);
			lcd.drawPixel((player1_x * 20) + pixelCounterX, (player1_y * 20) + pixelCounterY, RGB(red, green, blue));
			redPixelCounter += 3;
			greenPixelCounter += 3;
			bluePixelCounter += 3;
		}
	}
	redPixelCounter = 0;
	greenPixelCounter = 1;
	bluePixelCounter = 2;
}
